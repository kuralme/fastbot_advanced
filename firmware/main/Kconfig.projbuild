## firmware/main/Kconfig.projbuild
```kconfig
menu "micro-ROS example-app settings"

    config MICRO_ROS_STACK_SIZE
        int "Stack the micro-ROS app (Bytes)"
        default 16000
        help
        Stack size in Bytes of the micro-ROS app

    config MICRO_ROS_TASK_PRIO
        int "Priority of the micro-ROS app"
        default 5
        help
        Priority of micro-ros task higher value means higher priority
    
    config MICROROS_UART_TXD
        int "UART TXD GPIO"
        default 1

    config MICROROS_UART_RXD
        int "UART RXD GPIO"
        default 3
endmenu
```
